## CMakeLists.txt
```
cmake_minimum_required(VERSION 3.20.0)

find_package(Zephyr REQUIRED HINTS $ENV{ZEPHYR_BASE})
project(atk_native_zephyr_periodic)

# Reuse the Task 1 probe so native and virtualized runs use the same absolute
# deadline and cycle-counter measurement algorithm.
target_sources(app PRIVATE
  ${CMAKE_CURRENT_LIST_DIR}/../zephyr-periodic/src/main.c
  src/native_boot.c
)
target_compile_definitions(app PRIVATE RT_SAMPLE_COUNT=300 RT_START_DELAY_MS=0)
```

## prj.conf
```kconfig
CONFIG_SOC_PREP_HOOK=y
CONFIG_SERIAL=y
CONFIG_CONSOLE=y
CONFIG_UART_CONSOLE=y
CONFIG_PRINTK=y
CONFIG_MAIN_STACK_SIZE=2048
CONFIG_SYS_CLOCK_TICKS_PER_SEC=1000
CONFIG_ARMV8_A_NS=y
CONFIG_GIC_SAFE_CONFIG=y
CONFIG_BOOT_BANNER=n
```

## src/native_boot.c
```c
/*
 * SPDX-License-Identifier: Apache-2.0
 *
 * Earliest observable marker for the ATK-DLRK3588 native BL33 path.
 */

#include <stdint.h>

#define ATK_UART2_BASE 0xfeb50000UL
#define UART_THR       0x00UL
#define UART_LSR       0x14UL
#define UART_LSR_THRE  (1U << 5)

static void raw_putc(char value)
{
	volatile uint32_t *const lsr =
		(volatile uint32_t *)(ATK_UART2_BASE + UART_LSR);
	volatile uint32_t *const thr =
		(volatile uint32_t *)(ATK_UART2_BASE + UART_THR);

	for (unsigned int spin = 0; spin < 1000000U; ++spin) {
		if ((*lsr & UART_LSR_THRE) != 0U) {
			break;
		}
	}
	*thr = (uint32_t)(uint8_t)value;
}

static void raw_puts(const char *text)
{
	while (*text != '\0') {
		raw_putc(*text++);
	}
}

void soc_prep_hook(void)
{
	raw_puts("\r\nATK_NATIVE_PERIODIC_PREP\r\n");
}
```
